## west.yml
```yaml
manifest:
  remotes:
    - name: zephyrproject-rtos
      url-base: https://github.com/zephyrproject-rtos
  projects:
    - name: zephyr
      remote: zephyrproject-rtos
      revision: v2.1.0
      import: true
      project-path-prefix: zephyr_source

  self:
    path: my-zephyr-app
```
